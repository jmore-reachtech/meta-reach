## conf/bblayers.conf.sample
```bitbake
# LAYER_CONF_VERSION is increased each time build/conf/bblayers.conf
# changes incompatibly
LCONF_VERSION = "6"

BBPATH = "${TOPDIR}"
BBFILES ?= ""

BBLAYERS ?= " \
  /home/reach/yocto/reach-yocto/poky/meta \
  /home/reach/yocto/reach-yocto/poky/meta-yocto \
  /home/reach/yocto/reach-yocto/poky/meta-yocto-bsp \
  /home/reach/yocto/reach-yocto/meta-fsl-arm \
  /home/reach/yocto/reach-yocto/meta-reach \
  "
```

## conf/distro/reach-framebuffer.conf
```bitbake
# Reach Distro for FrameBuffer graphical backend.

require conf/distro/include/reach-base.inc

DISTRO = "reach-framebuffer"
DISTRO_NAME = "Reach Technology FrameBuffer"

DISTRO_FEATURES_append = "virtualization"

# Remove conflicting backends.
DISTRO_FEATURES_remove = "bluetooth 3g nfc x11 wayland directfb vulkan zeroconf"

# We do not want pulseaudio
DISTRO_FEATURES_BACKFILL_CONSIDERED = "\
    pulseaudio \
"
```

## conf/distro/reach-tiny.conf
```bitbake
# reach-tiny is intended to define a tiny Linux system comprised of 
# busybox, mdev, busybox-init, and not much else.

require conf/distro/reach.conf
DISTRO = "reach-tiny"

VIRTUAL-RUNTIME_dev_manager = "busybox"
VIRTUAL-RUNTIME_init_manager = ""
VIRTUAL-RUNTIME_initscripts = ""

DISTRO_FEATURES_BACKFILL_CONSIDERED += "\
    sysvinit \
"
```

## conf/distro/reach-x11.conf
```bitbake
require conf/distro/reach.conf
 
DISTRO = "reach-x11"
DISTROOVERRIDES = "reach"
 
DISTRO_FEATURES_append = " x11 pam"

# Remove conflicting backends.
DISTRO_FEATURES_remove = "wayland "
```

## conf/distro/reach.conf
```bitbake
# Use O.S. Systems Embedded Linux as base
require conf/distro/oel.conf

### Reach Technology Inc. specific settings

DISTRO = "reach"
DISTRO_NAME = "Reach Technology Embedded Linux"
DISTRO_VERSION = "2.2"
SDK_VENDOR = "-reachsdk"
SDK_VERSION := "${@'${DISTRO_VERSION}'.replace('snapshot-${DATE}','snapshot')}"

MAINTAINER = "Reach Technology Inc. <info@reachtech.com>"

TARGET_VENDOR = "-reach"

REACH_DEFAULT_DISTRO_FEATURES = "\
    argp \
    ext2 \
    largefile \
    nfs \
    opengl \
    ptest \
    usbgadget \
    usbhost \
    wifi \
    xattr \
    alsa \
    smbfs \
    vfat \
"

DISTRO_FEATURES = "\
    ${DISTRO_FEATURES_LIBC} \
    ${REACH_DEFAULT_DISTRO_FEATURES} \
"

DISTRO_FEATURES_BACKFILL_CONSIDERED = "\
    pulseaudio \
"

PREFERRED_VERSION_xserver-nodm-init ?= "1.0"

# Extend Qt5 settings
# QtWebEngine requires accessibility and ALSA support
PACKAGECONFIG_DISTRO_pn-qtbase = "accessibility alsa examples fontconfig sql-sqlite tslib"

# Enable GStreamer 1.0 support for QtMultimedia
PACKAGECONFIG_append_pn-qtmultimedia = ' gstreamer'

# Install wic dependencies
IMAGE_DEPENDS_wic_append = " dosfstools-native mtools-native"
```

## conf/layer.conf
```bitbake
# We have a conf and classes directory, add to BBPATH
BBPATH .= ":${LAYERDIR}"
# We have a packages directory, add to BBFILES
BBFILES += "${LAYERDIR}/recipes-*/*/*.bb \
			${LAYERDIR}/recipes-*/*/*.bbappend"

BBFILE_COLLECTIONS += "reach"
BBFILE_PATTERN_reach := "^${LAYERDIR}/"
BBFILE_PRIORITY_reach = "7"
```

## conf/local.conf.sample
```bitbake
# We need to set these items
DISTRO ?= "reach"
PACKAGE_CLASSES ?= "package_ipk"
EXTRA_IMAGE_FEATURES = "debug-tweaks"
USER_CLASSES ?= "buildstats image-mklibs image-prelink"
PATCHRESOLVE = "noop"
CONF_VERSION = "1"

# These are optional based on host computer
BB_NUMBER_THREADS = "32"
PARALLEL_MAKE = "-j 32"

# These can be share on a per developer workstation like /opt
DL_DIR ?= "/opt/yocto/downloads"
#SSTATE_DIR ?= "/opt/yocto/sstate"

ACCEPT_FSL_EULA = "1"

# Possibly make these available for download and sstate
#SSTATE_MIRRORS ?= "\
#file://.* http://someserver.tld/share/sstate/PATH \n \
#file://.* file:///some/local/dir/sstate/PATH"
INHERIT += "own-mirrors"
SOURCE_MIRROR_URL = "http://git.reachtech.com/downloads"

#SDKMACHINE ?= "i686"
```

## conf/machine/g2c-43-24-kyocera.conf
```bitbake
#@TYPE: Machine
#@NAME: Reach i.MX28 Canby
#@DESCRIPTION: Machine configuration for Reach i.MX28 Canby Board

include conf/machine/include/g2c-base.inc

IMAGE_FSTYPES ?= "tar.bz2 ext3 linux.sb sdcard ubi ubifs"
```

## conf/machine/g2c-43-24.conf
```bitbake
#@TYPE: Machine
#@NAME: Reach i.MX28 Canby
#@DESCRIPTION: Machine configuration for Reach i.MX28 Canby Board

include conf/machine/include/g2c-base.inc

IMXBOOTLETS_MACHINE = "iMX28_EVK"

IMAGE_BOOTLOADER = "imx-bootlets"

KERNEL_IMAGETYPE = "uImage"

EXTRA_IMAGEDEPENDS += "imx-bootlets-header-native"
MACHINE_EXTRA_RRECOMMENDS = " kernel-modules"

SDCARD_ROOTFS ?= "${DEPLOY_DIR_IMAGE}/${IMAGE_NAME}.rootfs.ext3"
IMAGE_FSTYPES ?= "tar.bz2 ext3 linux.sb sdcard ubi ubifs"

MKUBIFS_ARGS = "-m 2KiB -e 124KiB -c 1866"
UBINIZE_ARGS = "-m 2KiB -p 128KiB -s 2KiB"

MACHINE_FEATURES = "touchscreen"
USE_VT = "0"
```

## conf/machine/g2c-4_3-inch.conf
```bitbake
#@TYPE: Machine
#@NAME: Reach i.MX28 Canby
#@DESCRIPTION: Machine configuration for Reach i.MX28 Canby Board

include conf/machine/include/g2c-base.inc

IMAGE_FSTYPES_mxs += " sdcard ubi ubifs"

SIO_TTY = "/dev/ttyAPP0"
```

## conf/machine/g2c-7-16.conf
```bitbake
#@TYPE: Machine
#@NAME: Reach i.MX28 Canby
#@DESCRIPTION: Machine configuration for Reach i.MX28 Canby Board with 7" 18bit Display (16 bit Framebuffer)

include conf/machine/include/g2c-base.inc

IMAGE_FSTYPES ?= "tar.bz2 ext3 linux.sb sdcard ubi ubifs"
```

## conf/machine/g2c1.conf
```bitbake
#@TYPE: Machine
#@NAME: Reach i.MX28 Canby
#@DESCRIPTION: Machine configuration for Reach i.MX28 Canby Board

include conf/machine/include/g2c-base.inc

IMXBOOTLETS_MACHINE = "iMX28_EVK"

IMAGE_BOOTLOADER = "imx-bootlets"

KERNEL_IMAGETYPE = "zImage"

EXTRA_IMAGEDEPENDS += "imx-bootlets-header-native"

SDCARD_ROOTFS ?= "${DEPLOY_DIR_IMAGE}/${IMAGE_NAME}.rootfs.ext3"
IMAGE_FSTYPES ?= "tar.bz2 ext3 linux.sb sdcard"
```

## conf/machine/g2h-10_1-inch.conf
```bitbake
#@TYPE: Machine
#@NAME: G2H i.MX6 G2H DualLite
#@SOC: i.MX6DL
#@DESCRIPTION: Machine configuration for i.MX6 G2H 10.1" display

include conf/machine/include/g2h-base.inc

UBOOT_CONFIG = "g2h-10_1_spi_nor g2h-10_1_sd"

KERNEL_DEVICETREE = "imx6dl-g2h-11.dtb imx6dl-g2h-12.dtb"
```

## conf/machine/g2h-5_7-inch.conf
```bitbake
#@TYPE: Machine
#@NAME: G2H i.MX6 G2H DualLite
#@SOC: i.MX6DL
#@DESCRIPTION: Machine configuration for i.MX6 G2H 5.7" display

include conf/machine/include/g2h-base.inc

UBOOT_CONFIG = "g2h-5_7-inch"

KERNEL_DEVICETREE = "imx6dl-g2h-13.dtb imx6dl-g2h-14.dtb"
```

## conf/machine/g2h-5_7_f-inch.conf
```bitbake
#@TYPE: Machine
#@NAME: G2H i.MX6 G2H DualLite
#@SOC: i.MX6DL
#@DESCRIPTION: Machine configuration for i.MX6 G2H 5.7" display

include conf/machine/include/g2h-base.inc

UBOOT_CONFIG = "g2h-5_7_spi_nor g2h-5_7_sd"

KERNEL_DEVICETREE = "imx6dl-g2h-13f.dtb imx6dl-g2h-14f.dtb"

IMAGE_BOOT_FILES += " \
    zImage-imx6dl-g2h-13f.dtb;imx6dl-g2h-13f.dtb \
    zImage-imx6dl-g2h-14f.dtb;imx6dl-g2h-14f.dtb \
"
```

## conf/machine/g2h-7-inch.conf
```bitbake
#@TYPE: Machine
#@NAME: G2H i.MX6 G2H DualLite
#@SOC: i.MX6DL
#@DESCRIPTION: Machine configuration for i.MX6 G2H 7" display

include conf/machine/include/g2h-base.inc

UBOOT_CONFIG = "g2h-7_spi_nor g2h-7_sd"

KERNEL_DEVICETREE = "imx6dl-g2h-3.dtb imx6dl-g2h-4.dtb"
```

## conf/machine/g2h-solo-14f.conf
```bitbake
#@TYPE: Machine
#@NAME: G2H i.MX6 G2H DualLite
#@SOC: i.MX6DL
#@DESCRIPTION: Machine configuration for i.MX6 G2H DualLite

################################
# Reach Technology
# Panel:                7" WVGA
# Touch:                Everevision
# Display Interface:    Parallel
# LCD Clock:            PLL2 (default)
################################

include conf/machine/include/g2h-base.inc
require conf/machine/include/g2h-solo-base.inc

KERNEL_DEVICETREE = "imx6dl-g2h-14f.dtb"
```

## conf/machine/g2h-solo-2.conf
```bitbake
#@TYPE: Machine
#@NAME: G2H i.MX6 G2H DualLite
#@SOC: i.MX6DL
#@DESCRIPTION: Machine configuration for i.MX6 G2H DualLite

################################
# Reach Technology
# Panel:                5.7" VGA
# Touch:                TSC2046
# Display Interface:    LDB
# LCD Clock:            PLL5
################################

include conf/machine/include/g2h-base.inc

SOC_FAMILY = "mx6:mx6dl:g2h"

PREFERRED_PROVIDER_virtual/kernel = "linux-g2h"
PREFERRED_PROVIDER_virtual/bootloader = "u-boot-g2h"
PREFERRED_PROVIDER_u-boot = "u-boot-g2h"

# this config puts the env on SD
UBOOT_MACHINE = "g2h_solo_sd_config"

KERNEL_DEVICETREE = "imx6dl-g2h-2.dtb"

SERIAL_CONSOLE = "115200 ttymxc0"
SIO_TTY = "/dev/ttymxc1"

KERNEL_IMAGETYPE = "zImage"
```

## conf/machine/g2h-solo-4f.conf
```bitbake
#@TYPE: Machine
#@NAME: G2H i.MX6 G2H DualLite
#@SOC: i.MX6DL
#@DESCRIPTION: Machine configuration for i.MX6 G2H DualLite

################################
# Reach Technology
# Panel:                7" WVGA
# Touch:                TSC2046
# Display Interface:    Parallel
# LCD Clock:            PLL2 (default)
################################

include conf/machine/include/g2h-base.inc
require conf/machine/include/g2h-solo-base.inc

KERNEL_DEVICETREE = "imx6dl-g2h-4f.dtb"

UBOOT_MACHINE ?= "g2h_solo_4f_defconfig"
```

## conf/machine/g2h-solo-7.conf
```bitbake
#@TYPE: Machine
#@NAME: G2H i.MX6 G2H DualLite
#@SOC: i.MX6DL
#@DESCRIPTION: Machine configuration for i.MX6 G2H DualLite

################################
# Reach Technology
# Panel:                10.4" XGA
# Touch:                eGalax USB
# Display Interface:    LVDS
# LCD Clock:            PLL2 (default)
################################

include conf/machine/include/g2h-base.inc
require conf/machine/include/g2h-solo-base.inc

KERNEL_DEVICETREE = "imx6dl-g2h-7.dtb"

QPA_EVDEV_ROTATE = "270"

QPA_TOUCH_PLUGIN = "EvdevTouch"
```

## conf/machine/g2h-solo.conf
```bitbake
#@TYPE: Machine
#@NAME: Wandboard i.MX6 Wandboard Solo
#@SOC: i.MX6S
#@DESCRIPTION: Machine configuration for i.MX6 Wandboard Solo

include conf/machine/include/g2h-base.inc

SOC_FAMILY = "mx6:mx6dl:g2h"

PREFERRED_PROVIDER_virtual/kernel = "linux-g2h"
PREFERRED_PROVIDER_virtual/bootloader = "u-boot-g2h"
PREFERRED_PROVIDER_u-boot = "u-boot-g2h"

# this config puts the env on SD
UBOOT_MACHINE = "g2h_solo_sd_config"

KERNEL_DEVICETREE = "imx6sdl-hawthorne.dtb"

SERIAL_CONSOLE = "115200 ttymxc0"

KERNEL_IMAGETYPE = "zImage"
```

## conf/machine/g2s-101-24.conf
```bitbake
#@TYPE: Machine
#@NAME: i.MX53 Sellwood Board
#@DESCRIPTION: Machine configuration for Reach i.MX53 Sellwood Board

include conf/machine/include/tune-cortexa8.inc
include conf/machine/include/imx-base.inc

SOC_FAMILY = "mx5:mx53:g2s"

EXTRA_IMAGEDEPENDS = "barebox"
IMAGE_BOOTLOADER = "barebox"
PREFERRED_VERSION_barebox = "2012.11.0"

PREFERRED_PROVIDER_virtual/kernel = "linux-g2s"
KERNEL_IMAGETYPE = "zImage"

IMAGE_CLASSES += "image_types_reach"

# Disable perf features as 2.6.35.3 fail to build otherwise
PERF_FEATURES_ENABLE = ""

MACHINE_FIRMWARE += "\
    linux-firmware-ar3k \
    linux-firmware-ath6k \
"

MACHINE_FEATURES += " wifi bluetooth"

SIO_TTY = "/dev/ttymxc1"
```

## conf/machine/imx6dl-g3-emmc.conf
```bitbake
include imx6dl-g3.inc

MENDER_UBOOT_STORAGE_DEVICE = "1"
MENDER_STORAGE_DEVICE = "/dev/mmcblk3"

MENDER_IMAGE_BOOTLOADER_FILE = "u-boot-imx6dl-g3-emmc.imx"
```

## conf/machine/imx6dl-g3-sd.conf
```bitbake
include imx6dl-g3.inc

MENDER_UBOOT_STORAGE_DEVICE = "0"
MENDER_STORAGE_DEVICE = "/dev/mmcblk2"

MENDER_IMAGE_BOOTLOADER_FILE = "u-boot-imx6dl-g3-sd.imx"
```

## conf/machine/imx6dl-g3.inc
```bitbake
#@TYPE: Machine
#@NAME: reach

#@DESCRIPTION: Machine configuration for reach systems

MACHINEOVERRIDES =. "mx6:mx6dl:mx6q:"

include conf/machine/include/imx-base.inc
include conf/machine/include/tune-cortexa9.inc

KERNEL_DEVICETREE = " \
	imx6dl-g3-7res.dtb \
	imx6dl-g3-7pcap.dtb \
	imx6dl-g3-10p1res.dtb \
	imx6dl-g3-10p1pcap.dtb \
	imx6dl-g3-none.dtb \
"

KERNEL_IMAGETYPE = "zImage"

PREFERRED_PROVIDER_u-boot ?= "u-boot-reach"
PREFERRED_PROVIDER_virtual/bootloader ?= "u-boot-reach"

PREFERRED_PROVIDER_virtual/kernel ??= "linux-reach"
PREFERRED_PROVIDER_virtual/kernel_use-mainline-bsp ??= "linux-fslc"
PREFERRED_VERSION_linux-reach ??= "4.9"

UBOOT_MACHINE ?= "reach_imx6dl_g3_defconfig"

SERIAL_CONSOLE = "115200 ttymxc0"

MACHINE_ESSENTIAL_EXTRA_RDEPENDS += " \
    kernel-image \
    kernel-devicetree \
"
MACHINE_HAS_VIVANTE_KERNEL_DRIVER_SUPPORT = "1"
MACHINE_USES_VIVANTE_KERNEL_DRIVER_MODULE = "0"

MACHINE_FEATURES_BACKFILL_CONSIDERED = "rtc"

WKS_FILES = "imx-uboot.wks"

USE_VT = "0"

# Mender configuration

IMAGE_FSTYPES = ""

MENDER_ARTIFACT_NAME ?= "0.0.0.1"
ARTIFACTIMG_FSTYPE = "ext4"
IMAGE_ROOTFS_SIZE = "1048576"

MENDER_STORAGE_DEVICE = "/dev/mmcblk2"
MENDER_STORAGE_TOTAL_SIZE_MB = "2624"
MENDER_DATA_PART_SIZE_MB = "512"
MENDER_PARTITION_ALIGNMENT = "1048576"

MENDER_FEATURES_ENABLE_append = " mender-uboot mender-image mender-image-sd mender-install"
MENDER_FEATURES_DISABLE_append = " mender-systemd mender-grub mender-image-uefi"

MENDER_UBOOT_STORAGE_DEVICE = "0"
MENDER_UBOOT_STORAGE_INTERFACE = "mmc"
MENDER_UBOOT_ENV_STORAGE_DEVICE_OFFSET = "1048576"

MENDER_IMAGE_BOOTLOADER_BOOTSECTOR_OFFSET = "2"
```
