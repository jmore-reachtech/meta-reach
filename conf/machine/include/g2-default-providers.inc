## conf/machine/include/g2c-base.inc
```bitbake
# Provides the g2c common settings
# Include defaults from meta-fsl-arm
require conf/machine/include/imx-base.inc
include conf/machine/include/tune-arm926ejs.inc

SOC_FAMILY = "mxs:mx28:g2c"

PREFERRED_PROVIDER_u-boot = "u-boot-reach"
PREFERRED_PROVIDER_virtual/bootloader = "u-boot-reach"

UBOOT_CONFIG = "mmc nand"
UBOOT_CONFIG[mmc] = "g2c1_mmc_defconfig"
UBOOT_CONFIG[nand] = "g2c1_nand_defconfig"

PREFERRED_PROVIDER_virtual/kernel = "linux-reach"
PREFERRED_VERSION_linux-reach = "4.1%"

KERNEL_IMAGETYPE = "zImage"
KERNEL_DEVICETREE = "imx28-g2c1.dtb"

MACHINE_FEATURES = "touchscreen"
MACHINE_EXTRA_RRECOMMENDS = " kernel-modules"

MKUBIFS_ARGS = "-m 2KiB -e 124KiB -c 1866"
UBINIZE_ARGS = "-m 2KiB -p 128KiB -s 2KiB"

USE_VT = "0"

SERIAL_CONSOLE = "115200 ttyAM0"
```

## conf/machine/include/g2c-lite.inc
```bitbake
# Provides the g2c common settings

include conf/machine/include/soc-family.inc
include conf/machine/include/tune-arm926ejs.inc

SOC_FAMILY = "mxs"

# Sub-architecture support
MACHINE_SOCARCH ?= ""
MACHINE_SOCARCH_mxs = "${TUNE_PKGARCH}-mx28"
PACKAGE_EXTRA_ARCHS_append = " ${MACHINE_SOCARCH}"

# Disable perf features as 2.6.35.3 fail to build otherwise
PERF_FEATURES_ENABLE = ""

SERIAL_CONSOLE = "115200 ttyAM0"

PREFERRED_PROVIDER_virtual/kernel ?= "linux-g2cl"
PREFERRED_PROVIDER_u-boot ?= "u-boot-fslc"

IMAGE_CLASSES += "image_types_reach"

PREFERRED_VERSION_tslib ?= "1.1"
PREFERRED_VERSION_xserver-nodm-init ?= "1.0"

INHERIT += "fsl-dynamic-packagearch"
```

## conf/machine/include/g2h-base.inc
```bitbake
# Include Freescale i.MX base settings
require conf/machine/include/imx-base.inc
include conf/machine/include/tune-cortexa9.inc

USE_VT = "0"

SOC_FAMILY = "mx6:mx6dl:g2h"

PREFERRED_PROVIDER_u-boot = "u-boot-reach"
PREFERRED_PROVIDER_virtual/bootloader = "u-boot-reach"

UBOOT_CONFIG[g2h-10_1_sd] = "g2h_10_1_defconfig,sdcard"
UBOOT_CONFIG[g2h-10_1_spi_nor] = "g2h_10_1_spi_nor_defconfig,ubifs"
UBOOT_CONFIG[g2h-7_sd] = "g2h_7_defconfig,sdcard"
UBOOT_CONFIG[g2h-7_spi_nor] = "g2h_7_spi_nor_defconfig,ubifs"
UBOOT_CONFIG[g2h-5_7_sd] = "g2h_5_7_defconfig,sdcard"
UBOOT_CONFIG[g2h-5_7_spi_nor] = "g2h_5_7_spi_nor_defconfig,ubifs"

PREFERRED_PROVIDER_virtual/kernel = "linux-reach"
PREFERRED_VERSION_linux-reach = "3.14+%"

KERNEL_IMAGETYPE = "zImage"

IMAGE_FSTYPES = "wic.gz"
WKS_FILES_append = " g2h-base.wks"

IMAGE_BOOT_FILES = "\
    zImage \
    u-boot.imx \
"

SERIAL_CONSOLE = "115200 ttymxc0"
SIO_TTY = "/dev/ttymxc1"

MKUBIFS_ARGS = "-m 2KiB -e 124KiB -c 4096"
UBINIZE_ARGS = "-m 2KiB -p 128KiB -s 2KiB"

QPA_TOUCH_PLUGIN ?= "Tslib"

MACHINE_FEATURES_BACKFILL_CONSIDERED = "rtc"
```

## conf/machine/include/g2h-solo-base.inc
```bitbake
SOC_FAMILY = "mx6:mx6dl:g2h"

PREFERRED_PROVIDER_u-boot = "u-boot-g2h"
PREFERRED_PROVIDER_virtual/bootloader = "u-boot-g2h"
# this config puts the env on SD
UBOOT_MACHINE ?= "g2h_solo_sd_config"

PREFERRED_PROVIDER_virtual/kernel = "linux-g2h"
KERNEL_IMAGETYPE = "zImage"

SERIAL_CONSOLE = "115200 ttymxc0"

SIO_TTY = "/dev/ttymxc1"

MKUBIFS_ARGS = "-m 2KiB -e 124KiB -c 4096"
UBINIZE_ARGS = "-m 2KiB -p 128KiB -s 2KiB"

QPA_EVDEV_ROTATE ?= "0"
QPA_TOUCH_PLUGIN ?= "Tslib"
```

## conf/machine/reach.conf
```bitbake
#@TYPE: Machine
#@NAME: reach

#@DESCRIPTION: Machine configuration for reach systems

MACHINEOVERRIDES =. "mx6:mx6dl:mx6q:"

include conf/machine/include/imx-base.inc
include conf/machine/include/tune-cortexa9.inc

KERNEL_DEVICETREE = "imx6dl-g2h-7p.dtb"

KERNEL_IMAGETYPE = "zImage"

PREFERRED_PROVIDER_u-boot ?= "u-boot-reach"
PREFERRED_PROVIDER_virtual/bootloader ?= "u-boot-reach"
PREFERRED_PROVIDER_virtual/kernel ??= "linux-reach"
PREFERRED_PROVIDER_virtual/kernel_use-mainline-bsp ??= "linux-fslc"

UBOOT_MACHINE ?= "reach_rd6_7p_config"

SERIAL_CONSOLE = "115200 ttymxc0"

MACHINE_ESSENTIAL_EXTRA_RDEPENDS += " \
    kernel-image \
    kernel-devicetree \
"
MACHINE_HAS_VIVANTE_KERNEL_DRIVER_SUPPORT = "1"
MACHINE_USES_VIVANTE_KERNEL_DRIVER_MODULE = "0"

MACHINE_FEATURES_BACKFILL_CONSIDERED = "rtc"

WKS_FILES = "imx-uboot.wks"

USE_VT = "0"
```

## recipes-qt/images/reach-image-qt5-installer.wks
```
part u-boot --source rawcopy --sourceparams="file=u-boot.imx" --ondisk mmcblk --no-table --align 1
part /boot --source bootimg-partition --ondisk mmcblk --fstype=vfat --label boot --active --align 4096 --size 8M --extra-space 0
part / --source rootfs --ondisk mmcblk --fstype=ext4 --label root --align 4096
part /installer --ondisk mmcblk --fstype=ext4 --label installer --align 4096 --size 512M
```
